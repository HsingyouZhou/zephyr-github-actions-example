## west.yml
```yaml
manifest:
  projects:
    - name: zephyr
      revision: v4.2.0-rc3
      url: https://github.com/zephyrproject-rtos/zephyr
      import:
        name-allowlist:
          - cmsis
          - hal_nordic
```
